## Kconfig.defconfig
```kconfig
if BOARD_

config BOARD
	default "sifive_e21"

config RISCV_ROM_BASE_ADDR
	default 

endif
```

## templates/Kconfig.board
```kconfig
config BOARD_<BOARD_IDENTIFIER>
	bool 
	depends on SOC_RISCV32_SIFIVE_FREEDOM
	select HAS_DTS
```
